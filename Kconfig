## Kconfig
```kconfig
# temp/Kconfig - 用户区业务 Kconfig（位置：/home/rookie/zephyrproject/projects/temp）
# 业务门禁符号（PRJ_MAIN / TRD_XXX）保持原名，架构层 DUST_ 符号由
# framework 模块机制自动加载（module.yml kconfig: zephyr/Kconfig）。

config DEBUG_LOG
    bool "Enable Zephyr LOG output"
    default n
    select LOG
    select LOG_BACKEND_UART

config DEBUG_RTT
    bool "SEGGER RTT debug channel (log + variable print over probe)"
    default n
    select LOG
    select HAS_SEGGER_RTT
    select USE_SEGGER_RTT
    select LOG_BACKEND_RTT
    select SEGGER_RTT_CUSTOM_LOCKING
    help
      打开 SEGGER RTT：日志（LOG_INF/WRN/ERR）实时输出到调试探针的 RTT 通道，
      业务代码也可以用 SEGGER_RTT_printf() 直接打变量，不占 UART。

      RTT 走调试接口（SWD/JTAG）读写目标 RAM，所以需要 J-Link / OpenOCD
      之类的调试器在线；查看方法见 docs/segger_rtt.md。

      HAS_SEGGER_RTT 通常由 SoC 自己 select（STM32 会），这里显式 select
      让非 STM32 板卡（如 HPM5361 RISC-V）也能打开。

config PRJ_MAIN
    bool "Main business project"
    default n
    select DEBUG_LOG

if PRJ_MAIN

# =================               TRD_CONFIG                ====================

config TRD_GPIO
    bool "GPIO thread task"
    default n
    help
      Enable the GPIO idle thread.

config TRD_CAN
    bool "CAN thread task"
    default n
    select DUST_COM_CAN
    select DUST_TPC_TO_CAN_TX
    help
      Enable the CAN idle thread.

config TRD_MCU_INTER
    bool "MCU upper/lower board FDCAN thread"
    default n
    select DUST_COM_CAN
    select TRD_INTER_BUS
    select DUST_TPC_TO_MCU_TX
    select DUST_TPC_IMU_TO
    select DUST_TPC_REMOTE_TO
    select INTER_CMD
    help
      上板 → 下板发送线程。总线初始化由 TRD_INTER_BUS 负责（不再绑在发送线程上）。
      Note: 依赖设备树别名 inter-can。

config TRD_INTER_RX
    bool "Inter-board RX thread (from lower board)"
    default n
    select DUST_COM_CAN
    select TRD_INTER_BUS
    select DUST_TPC_FROM_BODY
    select INTER_CMD
    help
      上板 ← 下板接收线程：解析 Dir::Down 聚合状态帧（0x200）+ 超时判定 → zbus 发布。
      本项只注册 CAN_RX_HANDLER，总线初始化由 TRD_INTER_BUS 负责。

config TRD_INTER_BUS
    bool "Inter-board CAN bus owner (init only, no thread)"
    default n
    select DUST_COM_CAN
    help
      上下板通信总线所有者：只做 Can::Init(..., CAN_MODE_FD) + SetRxCallback，不建线程。
      由 TRD_MCU_INTER / TRD_INTER_RX 自动 select；也可单独打开用于
      "只调接收" / "只调发送"的调试场景。依赖设备树别名 inter-can。

config TRD_TEST
    bool "TEST thread task"
    default n
    help
      Enable the TEST thread.

config TRD_REMOTE
    bool "REMOTE thread task"
    default n
    select DUST_MOD_DEV_REMOTE
    select DUST_MOD_DEV_REMOTE_VT13
    help
      Enable the REMOTE thread.

config TRD_BOOSTER
    bool "BOOSTER thread task"
    default n
    select DUST_COM_CAN
    select DUST_CTL_PID
    select DUST_MOD_DEV_MOTOR_DJI
    select DUST_MOD_DEV_REMOTE
    select DUST_TPC_TO_CAN_TX
    help
      Enable the BOOSTER thread.
      发射机构线程：摩擦轮升速 + 拨弹盘进弹


config TRD_PC
    bool "PC (auto-aim) link thread"
    default n
    select DUST_COM_USB
    select DUST_TPC_IMU_TO
    select INTER_CMD
    help
      Enable the PC auto-aim link thread（USB CDC ACM）


config TRD_IMU
    bool "IMU thread task"
    default n
    select DUST_MOD_DEV_IMU
    help
      Enable the IMU thread.

choice TRD_IMU_SOURCE
    prompt "IMU source"
    default TRD_IMU_SRC_HIPNUC
    depends on TRD_IMU
    help
      选择底层 IMU 数据源。三种源互斥：链接段 .imu 只允许注册一个设备。

config TRD_IMU_SRC_BMI088
    bool "BMI088 (SPI, with heater)"
    select DUST_MOD_DEV_IMU_BMI088

config TRD_IMU_SRC_ICM42688P
    bool "ICM42688P (SPI, with heater)"
    select DUST_MOD_DEV_IMU_ICM42688P

config TRD_IMU_SRC_HIPNUC
    bool "HiPNUC (UART, fused output)"
    select DUST_MOD_DEV_IMU_HIPNUC

endchoice

endif # PRJ_MAIN

source "Kconfig.zephyr"
rsource "my_topic/Kconfig"
rsource "inter_cmd/Kconfig"
```

## dts/bindings/watchdog/hpmicro,hpm-ewdg.yaml
```yaml
description: HPM53 enhanced watchdog
compatible: "hpmicro,hpm-ewdg"
include: base.yaml

properties:
  reg:
    required: true
  interrupts:
    required: true
  clk-name:
    type: int
    required: true
```

## inter_cmd/Kconfig
```kconfig
config INTER_CMD
    bool "Inter-board command interface"
    default y
    help
      Shared command interface for the upper/lower board link.
```

## my_topic/Kconfig
```kconfig
config DUST_TPC_FROM_BODY
    default n
    bool "Lower board RX channel"
    select ZBUS
    help
        Received data contract from the lower board (state channel, zbus).
        Selected by TRD_INTER_RX.

config DUST_TPC_PC_TO
    default n
    bool "PC auto-aim topic"
    select ZBUS
    help
        PC auto-aim result (mode + yaw/pitch, state channel, zbus).
        Published by TRD_PC; consumer of TRD_MCU_INTER / TRD_BOOSTER.
```

## watchdog/Kconfig
```kconfig
menu "Watchdog supervisor"

config WDT_SUPERVISOR
	bool "Portable watchdog supervisor"
	default n
	select WATCHDOG
	help
	  Aggregate service heartbeats and feed the selected Zephyr watchdog.

config WDT_SUPERVISOR_FEED_PERIOD_MS
	int "Watchdog feed period (ms)"
	depends on WDT_SUPERVISOR
	default 50
	range 50 5000

config WDT_SUPERVISOR_TIMEOUT_MS
	int "Watchdog reset timeout (ms)"
	depends on WDT_SUPERVISOR
	default 2000
	range 200 60000

config WDT_SUPERVISOR_HEALTH_WARMUP_MS
	int "Watchdog health warm-up (ms)"
	depends on WDT_SUPERVISOR
	default 1000
	range 200 10000

endmenu

menu "HPM EWDG driver"

config WDT_HPMICRO
	bool "HPM53 EWDG hardware driver"
	default n
	depends on DT_HAS_HPMICRO_HPM_EWDG_ENABLED
	select WATCHDOG
	help
	  Enable the HPM EWDG driver through the Zephyr watchdog API.

config WDT_HPMICRO_WARNING_MS
	int "EWDG pre-reset warning lead (ms)"
	depends on WDT_HPMICRO
	default 100
	range 50 1000

endmenu
```
